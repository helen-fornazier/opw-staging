## drivers/media/platform/tpg/Kconfig
```kconfig
config VIDEO_TPG
	tristate "Test Pattern Generator (TPG)"
	default n
	---help---
	  Export functions to generate image patterns used in vivid and vimc drivers
```

## drivers/media/platform/vimc/Kconfig
```kconfig
config VIDEO_VIMC
	tristate "Virtual Media Controller Driver (VIMC)"
	depends on VIDEO_DEV && VIDEO_V4L2 && VIDEO_V4L2_SUBDEV_API && CONFIGFS_FS
	select VIDEOBUF2_VMALLOC
	select VIDEO_V4L2_TPG
	default n
	---help---
	  Virtual Media Controller Driver

	  This driver can be compared to the vivid driver for emulating
	  a media node that exposes a complex media topology. The topology
	  is configurable through configfs API.

	  When in doubt, say N.

config  VIDEO_VIMC_DEBUG
	bool "Enable Debug"
	depends on VIDEO_VIMC
	default n
	---help---
	  Enable the inclusion of debug code in the VIDEO_VIMC.
	  When in doubt, say N.
```
